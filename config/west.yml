## config/west.yml
```yaml
manifest:
  remotes:
  
    - name: zmkfirmware
      url-base: https://github.com/zmkfirmware
      
    - name: urob
      url-base: https://github.com/urob
      
    - name: zzeneg
      url-base: https://github.com/zzeneg
      
    - name: srwi
      url-base: https://github.com/srwi
      
  projects:
  
    - name: zmk
      remote: zmkfirmware
      revision: v0.3
      import: app/west.yml
      
    - name: zmk-helpers
      remote: urob
      revision: v0.3 # Should match ZMK release.
      
    - name: zmk-raw-hid
      remote: zzeneg
      revision: main
      
    - name: zmk-keypeek-layer-notifier
      remote: srwi
      revision: master
      
  self:
    path: config
```
